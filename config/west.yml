## config/west.yml
```yaml
manifest:
  remotes:
    - name: zmkfirmware
      url-base: https://github.com/zmkfirmware
    - name: cjpeterein
      url-base: https://github.com/cjpeterein
  projects:
    - name: zmk
      remote: zmkfirmware
      revision: v0.3
      import: app/west.yml
    - name: zmk-split-display-view
      remote: cjpeterein
      revision: main
  self:
    path: config
```
